## main/Kconfig.projbuild
```kconfig
menu "TrackCluster — Right cluster pin map (Waveshare ESP32-S3-Touch-LCD-2.8C)"

    # ── Pin assignments verified against ESP32-S3-Touch-LCD-2.8C schematic ──
    #
    # Board-reserved GPIOs (do NOT reassign):
    #   GPIO 1        → LCD_SDA (panel SPI init, shared with SD MOSI)
    #   GPIO 2        → LCD_SCK (panel SPI init, shared with SD SCK)
    #   GPIO 3        → R2
    #   GPIO 5        → B1
    #   GPIO 6        → BL_PWM  ← EXTERNAL PWM CONTROLLER — firmware does NOT touch
    #   GPIO 7        → I²C SCL (TCA9554, GT911, IMU, RTC — shared bus)
    #   GPIO 8        → R3
    #   GPIO 9–14     → G5–G0
    #   GPIO 15       → I²C SDA
    #   GPIO 16       → TP_INT (GT911 interrupt)
    #   GPIO 17–18    → R5, R4
    #   GPIO 21       → B5
    #   GPIO 38–41    → HSYNC, VSYNC, DE, PCLK
    #   GPIO 45–48    → B2–B4, R1
    #   GPIO 43       → UART0 TX (J9) — inter-cluster TX reserved
    #   GPIO 44       → UART0 RX (J9) — inter-cluster RX from center
    #
    # TCA9554 I/O expander (addr 0x20 on I²C bus):
    #   P0 = LCD_RST  P1 = TP_RST  P2 = LCD_CS  P4 = SD_CS
    #
    # Backlight: GPIO6 (BL_PWM) is driven by an external PWM controller wired
    # to the display FPC connector. The firmware never touches GPIO6.

    config TC_UART_RX_GPIO
        int "UART RX GPIO ← center cluster TX (J9 connector)"
        range 0 48
        default 44
        help
            GPIO44 is the UART0 RX broken out on J9. The center board's
            UART1 TX (GPIO17) connects here. Firmware maps UART1 to this pin.

    config TC_UART_TX_GPIO
        int "UART TX GPIO → center cluster RX (J9 connector, reserved)"
        range 0 48
        default 43

    config TC_I2C_SCL_GPIO
        int "I²C SCL (TCA9554 expander + GT911 touch)"
        range 0 48
        default 7

    config TC_I2C_SDA_GPIO
        int "I²C SDA"
        range 0 48
        default 15

    config TC_TP_INT_GPIO
        int "GT911 touch interrupt"
        range 0 48
        default 16

endmenu
```

## sdkconfig.defaults
```kconfig
# ─────────────────────────────────────────────────────────────────────────────
# TrackCluster RIGHT — ESP32-S3-Touch-LCD-2.8C — build defaults
# Applied automatically on `idf.py set-target esp32s3` / first build.
# ─────────────────────────────────────────────────────────────────────────────
CONFIG_IDF_TARGET="esp32s3"

# ── PSRAM (REQUIRED) ─────────────────────────────────────────────────────────
# The ST7701 RGB framebuffer lives in PSRAM (bsp.c sets fb_in_psram = true).
# ESP32-S3R8 = 8 MB Octal PSRAM. WITHOUT PSRAM THE PANEL INIT FAILS / SCREEN BLACK.
CONFIG_SPIRAM=y
CONFIG_SPIRAM_MODE_OCT=y
CONFIG_SPIRAM_SPEED_80M=y

# ── Flash ── the 2.8C board ships with 16 MB; confirm against your board.
CONFIG_ESPTOOLPY_FLASHSIZE_16MB=y
CONFIG_ESPTOOLPY_FLASHMODE_QIO=y
CONFIG_ESPTOOLPY_FLASHFREQ_80M=y

# ── CPU at full speed for smooth RGB refresh ─────────────────────────────────
CONFIG_ESP_DEFAULT_CPU_FREQ_MHZ_240=y

# ── Custom partition table ───────────────────────────────────────────────────
CONFIG_PARTITION_TABLE_CUSTOM=y
CONFIG_PARTITION_TABLE_CUSTOM_FILENAME="partitions.csv"

# ── RGB LCD smoothness ───────────────────────────────────────────────────────
# Keep the RGB DMA/flush ISR in IRAM so PSRAM cache misses don't stall the panel
# (prevents tearing/flicker). bsp.c already uses a bounce buffer, required for this.
CONFIG_LCD_RGB_ISR_IRAM_SAFE=y
CONFIG_GDMA_CTRL_FUNC_IN_IRAM=y

# ── LVGL settings (carried over from center bring-up) ─────────────────────────
# Compressed-font decoder: the ui/fonts/*.c are exported bitmap_format=1
# (LV_FONT_FMT_TXT_COMPRESSED) — without this every glyph renders as a tofu box.
CONFIG_LV_USE_FONT_COMPRESSED=y
# clib malloc → LVGL draws from the FreeRTOS heap (incl. PSRAM), so the lambda /
# bar-gauge / warning draw tasks aren't capped by LVGL's static builtin pool.
CONFIG_LV_USE_BUILTIN_MALLOC=n
CONFIG_LV_USE_CLIB_MALLOC=y
# 1 kHz tick + 8 ms refresh for smooth animation (default 100 Hz is too coarse).
CONFIG_FREERTOS_HZ=1000
CONFIG_LV_DEF_REFR_PERIOD=5

# ── BENCH MODE: OFF (UART from center) ───────────────────────────────────────
# CONFIG_TC_BENCH_MODE is not set

# ── Logging: ERROR only (UART console stays on for USB flash/monitor) ────────
CONFIG_BOOTLOADER_LOG_LEVEL_ERROR=y
CONFIG_LOG_DEFAULT_LEVEL_ERROR=y
```

## sdkconfig.defaults.esp32s3
```kconfig
CONFIG_IDF_TARGET="esp32s3"
CONFIG_IDF_TARGET_ESP32S3=y
CONFIG_FREERTOS_UNICORE=n
CONFIG_ESP32S3_DEFAULT_CPU_FREQ_240=y
CONFIG_SPIRAM=y
CONFIG_SPIRAM_MODE_OCT=y
CONFIG_SPIRAM_TYPE_AUTO=y
CONFIG_SPIRAM_SPEED_80M=y
CONFIG_SPIRAM_USE_MALLOC=y
CONFIG_ESPTOOLPY_FLASHSIZE_8MB=y
CONFIG_ESPTOOLPY_FLASHSIZE="8MB"
CONFIG_ESPTOOLPY_FLASHMODE_QIO=y
CONFIG_ESPTOOLPY_FLASHFREQ_80M=y
```
